## package/ax-bitstreams/Config.in
```kconfig
config BR2_PACKAGE_AX_BITSTREAMS
	bool "Axent FPGA Bitstreams"
	help
	  The Axent bitstreams are programming files for the FPGA
	  on board the AG11005 board, to allow it to drive different
	  types of LED display.
```

## package/ax-displayutils/Config.in
```kconfig
config BR2_PACKAGE_AX_DISPLAYUTILS
	bool "ax-displayutils"
	depends on BR2_PACKAGE_PYTHON
	help
	  Display configuration utilities for AG14003.

	  https://git.axent.com.au/ag14003/axent_displayutils
```

## package/ax-smil-python/Config.in
```kconfig
config BR2_PACKAGE_AX_SMIL_PYTHON
	bool "ax-smil-python"
	depends on BR2_PACKAGE_PYTHON && BR2_PACKAGE_PYCAIRO && BR2_PACKAGE_PIL
	help
	  ax-smil is a SMIL 3.0 player written in Python.

	  https://bitbucket.org/axent/axent_smil
```

## package/ax-smil/Config.in
```kconfig
config BR2_PACKAGE_AX_SMIL
	bool "ax-smil"
	depends on BR2_PACKAGE_CAIRO
	help
	  ax-smil is a SMIL 3.0 player written in C++.

	  https://git.axent.com.au/axent-smil-player/axent_smil_cpp
```

## package/ax-utils-ag11005/Config.in
```kconfig
config BR2_PACKAGE_AX_UTILS_AG11005
	bool "ax-utils-ag11005"
	depends on BR2_PACKAGE_PYTHON
	help
	  ax-utils are a collection of utilities for Axent systems
	  which do things like package management, disply configuration,
	  network configuration and remote management and diagnostics.

	  https://git.axent.com.au/ag11005-controller/axent_utils
```

## package/ax-utils-ag13008/Config.in
```kconfig
config BR2_PACKAGE_AX_UTILS_AG13008
	bool "ax-utils-ag13008"
	depends on BR2_PACKAGE_PYTHON
	help
	  ax-utils are a collection of utilities for Axent systems
	  which do things like package management, disply configuration,
	  network configuration and remote management and diagnostics.

	  https://git.axent.com.au/ag13008/axent_utils
```

## package/ax-utils-ag14003/Config.in
```kconfig
config BR2_PACKAGE_AX_UTILS_AG14003
	bool "ax-utils-ag14003"
	depends on BR2_PACKAGE_PYTHON
	help
	  ax-utils are a collection of utilities for Axent systems
	  which do things like package management, disply configuration,
	  network configuration and remote management and diagnostics.

	  https://git.axent.com.au/ag14003/axent_utils
```

## package/fbc/Config.in
```kconfig
config BR2_PACKAGE_FBC
	bool "fbc"
	help
	  fbc is a very simple utility which sets the colour map
	  of a specified framebuffer device to a gamma curve with
	  optional offsets for red, green and blue.

	  http://github.com/danieldyer/fbc
```

## package/jsonrpclib/Config.in
```kconfig
config BR2_PACKAGE_JSONRPCLIB
	bool "jsonrpclib"
	help
	  JSONRPCLIB is a python library which implements the
	  JSON-RPC protocol.

	  http://github.com/joshmarshall/jsonrpclib
```
